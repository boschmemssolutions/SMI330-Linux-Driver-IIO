## drivers/iio/imu/smi330/Kconfig
```kconfig
# SPDX-License-Identifier: GPL-2.0
#
# SMI330 IMU driver
#

config SMI330
	tristate
	select IIO_BUFFER
	select IIO_TRIGGERED_BUFFER

config SMI330_I2C
	tristate "Bosch SMI330 I2C driver"
	depends on I2C
	select SMI330
	select REGMAP_I2C
	help
	  Enable support for the Bosch SMI330 6-Axis IMU connected to I2C
	  interface.

	  This driver can also be built as a module. If so, the module will be
	  called smi330_i2c.

config SMI330_SPI
	tristate "Bosch SMI330 SPI driver"
	depends on SPI
	select SMI330
	select REGMAP_SPI
	help
	  Enable support for the Bosch SMI330 6-Axis IMU connected to SPI
	  interface.

	  This driver can also be built as a module. If so, the module will be
	  called smi330_spi.

if SMI330

choice
	prompt "Map data interrupt"
	default SMI330_IRQ_DATA_INT1
	help
	  Map data interrupt to INT1 or INT2.

	  NONE: data interrupt disabled
	  INT1: data interrupt mapped to INT1
	  INT2: data interrupt mapped to INT2

	config SMI330_IRQ_DATA_NONE
		bool "NONE"
		help
		  Data interrupt disabled.

		  In this mode only polling is possible.
		  To activate data ready of fifo mode choose
		  INT1 or INT2.

	config SMI330_IRQ_DATA_INT1
		bool "INT1"
		help
		  Data interrupt mapped to INT1.

		  In this mode data ready is the default mode.
		  The interrupt is triggered when new data is available.
		  When fifo watermark is set, fifo mode is activated.
		  The interrupt is triggered when fifo watermark level is reached.

	config SMI330_IRQ_DATA_INT2
		bool "INT2"
		help
		  Data interrupt mapped to INT2.

		  In this mode data ready is the default mode.
		  The interrupt is triggered when new data is available.
		  When fifo watermark is set, fifo mode is activated.
		  The interrupt is triggered when fifo watermark level is reached.
endchoice

choice
	prompt "Map advanced features interrupt"
	default SMI330_IRQ_ADV_FEAT_NONE
	help
	  Map advanced features interrupt to INT1 or INT2.

	  NONE: advanced features interrupt disabled
	  INT1: advanced features interrupt mapped to INT1
	  INT2: advanced features interrupt mapped to INT2

	config SMI330_IRQ_ADV_FEAT_NONE
		bool "NONE"
		help
		  Advanced features interrupt disabled.

		  In this mode no-motion, any-motion or tilt detection
		  is disabled.
		  To enable these features choose INT1 or INT2.

	config SMI330_IRQ_ADV_FEAT_INT1
		bool "INT1"
		help
		  Advanced features interrupt mapped to INT1.

		  In this mode no-motion, any-motion or tilt detection
		  is enabled.
		  The interrupt is triggered when the feature is detected.

	config SMI330_IRQ_ADV_FEAT_INT2
		bool "INT2"
		help
		  Advanced features interrupt mapped to INT1.

		  In this mode no-motion, any-motion or tilt detection
		  is enabled.
		  The interrupt is triggered when the feature is detected.
endchoice

endif  # SMI330
```
